## source/linux-5.4.99/drivers/thermal/Kconfig
```kconfig
# SPDX-License-Identifier: GPL-2.0-only
#
# Generic thermal sysfs drivers configuration
#

menuconfig THERMAL
	bool "Generic Thermal sysfs driver"
	help
	  Generic Thermal Sysfs driver offers a generic mechanism for
	  thermal management. Usually it's made up of one or more thermal
	  zone and cooling device.
	  Each thermal zone contains its own temperature, trip points,
	  cooling devices.
	  All platforms with ACPI thermal support can use this driver.
	  If you want this support, you should say Y here.

if THERMAL

config THERMAL_OF
	bool
	prompt "APIs to parse thermal data out of device tree"
	depends on OF
	default y
	help
	  This options provides helpers to add the support to
	  read and parse thermal data definitions out of the
	  device tree blob.

	  Say 'Y' here if you need to build thermal infrastructure
	  based on device tree.

config THERMAL_EMERGENCY_POWEROFF_DELAY_MS                                   
    int "Emergency poweroff delay in milli-seconds"                          
    default 0                                                                
    help                                                                     
    | Thermal subsystem will issue a graceful shutdown when                  
    | critical temperatures are reached using orderly_poweroff(). In         
    | case of failure of an orderly_poweroff(), the thermal emergency        
    | poweroff kicks in after a delay has elapsed and shuts down the system. 
    | This config is number of milliseconds to delay before emergency        
    | poweroff kicks in. Similarly to the critical trip point,               
    | the delay should be carefully profiled so as to give adequate          
    | time for orderly_poweroff() to finish on regular execution.            
    | If set to 0 emergency poweroff will not be supported.                  
                                                                             
    | In doubt, leave as 0.                                                  

choice                                                             
    prompt "Default Thermal governor"                              
    default THERMAL_DEFAULT_GOV_STEP_WISE                          
    help                                                           
    | This option sets which thermal governor shall be loaded at   
    | startup. If in doubt, select 'step_wise'.                    
                                                                   
config THERMAL_DEFAULT_GOV_STEP_WISE                               
    bool "step_wise"                                               
    select THERMAL_GOV_STEP_WISE                                   
    help                                                           
    | Use the step_wise governor as default. This throttles the    
    | devices one step at a time.                                  
                                                                   
config THERMAL_DEFAULT_GOV_FAIR_SHARE                              
    bool "fair_share"                                              
    select THERMAL_GOV_FAIR_SHARE                                  
    help                                                           
    | Use the fair_share governor as default. This throttles the   
    | devices based on their 'contribution' to a zone. The         
    | contribution should be provided through platform data.       
                                                                   
config THERMAL_DEFAULT_GOV_USER_SPACE                              
    bool "user_space"                                              
    select THERMAL_GOV_USER_SPACE                                  
    help                                                           
    | Select this if you want to let the user space manage the     
    | platform thermals.                                           
                                                                   
config THERMAL_DEFAULT_GOV_POWER_ALLOCATOR                         
    bool "power_allocator"                                         
    select THERMAL_GOV_POWER_ALLOCATOR                             
    help                                                           
    | Select this if you want to control temperature based on      
    | system and device power allocation. This governor can only   
    | operate on cooling devices that implement the power API.     
                                                                   
endchoice                

config THERMAL_GOV_STEP_WISE
	bool "Step_wise thermal governor"
	help
	  Enable this to manage platform thermals using a simple linear
	  governor.

config CPU_THERMAL
	bool "Generic cpu cooling support"
	depends on CPU_FREQ
	depends on THERMAL_OF
	help
	  This implements the generic cpu cooling mechanism through frequency
	  reduction. An ACPI version of this already exists
	  (drivers/acpi/processor_thermal.c).
	  This will be useful for platforms using the generic thermal interface
	  and not the ACPI interface.

	  If you want this support, you should say Y here.

endif
```

## source/u-boot-2020.07/drivers/Kconfig
```kconfig
menu "Device Drivers"

source "drivers/core/Kconfig"

# types of drivers sorted in alphabetical order

source "drivers/block/Kconfig"

source "drivers/clk/Kconfig"

source "drivers/cpu/Kconfig"

source "drivers/crypto/Kconfig"

source "drivers/board/Kconfig"

source "drivers/dfu/Kconfig"

source "drivers/gpio/Kconfig"

source "drivers/input/Kconfig"

source "drivers/mmc/Kconfig"

source "drivers/mtd/Kconfig"

source "drivers/phy/Kconfig"

source "drivers/phy/allwinner/Kconfig"

source "drivers/reset/Kconfig"

source "drivers/rtc/Kconfig"

source "drivers/serial/Kconfig"

source "drivers/spi/Kconfig"

source "drivers/usb/Kconfig"

source "drivers/video/Kconfig"

config PHYS_TO_BUS
	bool "Custom physical to bus address mapping"
	help
	  Some SoCs use a different address map for CPU physical addresses and
	  peripheral DMA master accesses. If yours does, select this option in
	  your platform's Kconfig, and implement the appropriate mapping
	  functions in your platform's support code.

endmenu
```

## source/u-boot-2020.07/drivers/clk/Kconfig
```kconfig
menu "Clock"

config CLK
	bool "Enable clock driver support"
	depends on DM
	help
	  This allows drivers to be provided for clock generators, including
	  oscillators and PLLs. Devices can use a common clock API to request
	  a particular clock rate and check on available clocks. Clocks can
	  feed into other clocks in a tree structure, with multiplexers to
	  choose the source for each clock.

source "drivers/clk/sunxi/Kconfig"

endmenu
```

## source/u-boot-2020.07/drivers/clk/sunxi/Kconfig
```kconfig
config CLK_SUNXI
	bool "Clock support for Allwinner SoCs"
	depends on CLK && ARCH_SUNXI
	select DM_RESET
	default y
	help
	  This enables support for common clock driver API on Allwinner
	  SoCs.

if CLK_SUNXI

config CLK_SUNIV
	bool "Clock driver for Allwinner SUNIV"
	default MACH_SUNIV
	help
	  This enables common clock driver support for platforms based
	  on Allwinner F1C100s SoC.

endif # CLK_SUNXI
```

## source/u-boot-2020.07/drivers/dfu/Kconfig
```kconfig
menu "DFU support"

config DFU
	bool
	imply DFU_OVER_USB if USB_GADGET

config DFU_OVER_USB
	bool
	select HASH
	depends on USB_GADGET

if DFU
config DFU_TIMEOUT
	bool "Timeout waiting for DFU"
	help
	  This option adds an optional timeout parameter for DFU which, if set,
	  will cause DFU to only wait for that many seconds before exiting.

config DFU_MMC
	bool "MMC back end for DFU"
	help
	  This option enables using DFU to read and write to MMC based storage.

config DFU_SF
	bool "SPI flash back end for DFU"
	help
	  This option enables using DFU to read and write to SPI flash based
	  storage.

config DFU_SF_PART
	bool "MTD partition support for SPI flash back end"
	depends on DFU_SF && CMD_MTDPARTS
	default y
	help
	  This option enables the support of "part" and "partubi" target in
	  SPI flash DFU back end.

config DFU_MTD
	bool "MTD back end for DFU"
	depends on DM_MTD
	help
	  This option enables using DFU to read and write to on any MTD device.

config SET_DFU_ALT_INFO
	bool "Dynamic set of DFU alternate information"
	help
	  This option allows to call the function set_dfu_alt_info to
	  dynamically build dfu_alt_info in board.
endif
endmenu
```

## source/u-boot-2020.07/drivers/reset/Kconfig
```kconfig
menu "Reset Controller Support"

config DM_RESET
	bool "Enable reset controllers using Driver Model"
	depends on DM && OF_CONTROL
	help
	  Enable support for the reset controller driver class. Many hardware
	  modules are equipped with a reset signal, typically driven by some
	  reset controller hardware module within the chip. In U-Boot, reset
	  controller drivers allow control over these reset signals. In some
	  cases this API is applicable to chips outside the CPU as well,
	  although driving such reset isgnals using GPIOs may be more
	  appropriate in this case.

config RESET_SUNXI
	bool "RESET support for Allwinner SoCs"
	depends on DM_RESET && ARCH_SUNXI
	default y
	help
	  This enables support for common reset driver for
	  Allwinner SoCs.

endmenu
```

## source/u-boot-2020.07/drivers/spi/Kconfig
```kconfig
menuconfig SPI
	bool "SPI Support"
	help
	  The "Serial Peripheral Interface" is a low level synchronous
          protocol.  Chips that support SPI can have data transfer rates
          up to several tens of Mbit/sec.  Chips are addressed with a
          controller and a chipselect.  Most SPI slaves don't support
          dynamic device discovery; some are even write-only or read-only.

          SPI is widely used by microcontrollers to talk with sensors,
          eeprom and flash memory, codecs and various other controller
          chips, analog to digital (and d-to-a) converters, and more.
          MMC and SD cards can be accessed using SPI protocol; and for
          DataFlash cards used in MMC sockets, SPI must always be used.

          SPI is one of a family of similar protocols using a four wire
          interface (select, clock, data in, data out) including Microwire
          (half duplex), SSP, SSI, and PSP.  This driver framework should
          work with most such devices and controllers.

if SPI

config DM_SPI
	bool "Enable Driver Model for SPI drivers"
	depends on DM
	help
	  Enable driver model for SPI. The SPI slave interface
	  (spi_setup_slave(), spi_xfer(), etc.) is then implemented by
	  the SPI uclass. Drivers provide methods to access the SPI
	  buses that they control. The uclass interface is defined in
	  include/spi.h. The existing spi_slave structure is attached
	  as 'parent data' to every slave on each bus. Slaves
	  typically use driver-private data instead of extending the
	  spi_slave structure.

config SPI_MEM
	bool "SPI memory extension"
	help
	  Enable this option if you want to enable the SPI memory extension.
	  This extension is meant to simplify interaction with SPI memories
	  by providing an high-level interface to send memory-like commands.

if DM_SPI

config SPI_SUNXI
	bool "Allwinner SoC SPI controllers"
	default ARCH_SUNXI
	help
	  Enable the Allwinner SoC SPi controller driver.

	  Same controller driver can reuse in all Allwinner SoC variants.

endif # if DM_SPI

endif # menu "SPI Support"
```

## source/u-boot-2020.07/drivers/usb/host/Kconfig
```kconfig
#
# USB Host Controller Drivers
#
comment "USB Host Controller Drivers"

config USB_HOST
	bool
```
